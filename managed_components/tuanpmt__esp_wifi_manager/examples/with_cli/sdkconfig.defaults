## managed_components/tuanpmt__esp_wifi_manager/examples/with_cli/sdkconfig.defaults
```kconfig
CONFIG_IDF_TARGET="esp32s3"

# Enable WiFi Manager CLI
CONFIG_WIFI_MGR_ENABLE_CLI=y

# ESP Console settings
CONFIG_ESP_CONSOLE_USB_SERIAL_JTAG=y
```

## managed_components/tuanpmt__esp_wifi_manager/examples/with_webui/sdkconfig.defaults
```kconfig
CONFIG_IDF_TARGET="esp32s3"

# Enable WiFi Manager Web UI
CONFIG_WIFI_MGR_ENABLE_WEBUI=y
```

## managed_components/tuanpmt__esp_wifi_manager/examples/with_webui_customize/sdkconfig.defaults
```kconfig
CONFIG_IDF_TARGET="esp32s3"

# Enable WiFi Manager Web UI with custom path
CONFIG_WIFI_MGR_ENABLE_WEBUI=y
CONFIG_WIFI_MGR_WEBUI_CUSTOM_PATH="/littlefs"

# Partition table
CONFIG_PARTITION_TABLE_CUSTOM=y
CONFIG_PARTITION_TABLE_CUSTOM_FILENAME="partitions.csv"
```
